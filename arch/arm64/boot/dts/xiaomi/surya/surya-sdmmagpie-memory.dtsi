&reserved_memory {
	/* reserve for pstore */
	ramoops_mem: ramoops@9d800000 {
		compatible = "ramoops";
		reg = <0x0 0x9d800000 0x0 0x00400000>;

		record-size = <0x80000>;
		pmsg-size = <0x200000>;
		console-size = <0x100000>;
	};
};
